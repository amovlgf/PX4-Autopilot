## src/systemcmds/hw_test/Kconfig
```kconfig
menuconfig SYSTEMCMDS_HW_TEST
	bool "hw_test"
	default n
	depends on PLATFORM_NUTTX && !BOARD_CONSTRAINED_FLASH
	select SYSTEMCMDS_MTD
	---help---
		Enable support for hw_test

config BOARD_FLYCORE_Q_HW_TEST
	bool "Flycore-Q incoming inspection"
	default n
	depends on SYSTEMCMDS_HW_TEST
	select SYSTEMCMDS_SD_BENCH
	---help---
		Enable the Flycore-Q fixture tests and dedicated MAVLink service.

menuconfig USER_HW_TEST
	bool "hw_test running as userspace module"
	default y
	depends on BOARD_PROTECTED && SYSTEMCMDS_HW_TEST
	---help---
		Put hw_test in userspace memory
```
