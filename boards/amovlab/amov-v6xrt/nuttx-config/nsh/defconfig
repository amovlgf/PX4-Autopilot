## src/drivers/imu/bosch/bmi088_i2c/Kconfig
```kconfig
menuconfig DRIVERS_IMU_BOSCH_BMI088_I2C
	bool "bosch bmi088_i2c"
	default n
	---help---
		Enable support for bosch bmi088_i2c (can be enabled together with SPI bmi088 for dual-bus setups)
```

## src/systemcmds/hw_test/Kconfig
```kconfig
menuconfig SYSTEMCMDS_HW_TEST
	bool "hw_test"
	default n
	depends on PLATFORM_NUTTX && !BOARD_CONSTRAINED_FLASH
	select SYSTEMCMDS_MTD
	---help---
		Enable support for hw_test

menuconfig USER_HW_TEST
	bool "hw_test running as userspace module"
	default y
	depends on BOARD_PROTECTED && SYSTEMCMDS_HW_TEST
	---help---
		Put hw_test in userspace memory
```
